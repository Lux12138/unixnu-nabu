## configs/nabu_defconfig
```kconfig
CONFIG_XNU_BUILD_ARCHIVES=y
CONFIG_XNU_SOURCE_CORECRYPTO14=y
CONFIG_XNU_SOURCE_PTHREAD=y
CONFIG_XNU_ARM_DT_PLATFORM=y
CONFIG_XNU_ARMCPU=y
CONFIG_XNU_CRYPTO_BOOTSTRAP="prelinked"
CONFIG_XNU_DT_PANIC_REGION=y
CONFIG_XNU_EXTRA_LD_ARCHIVES="/root/merge/UniXNU-nabu/build/libQcomXnuUsbDebug.a"
CONFIG_XNU_NATIVE_LEGACY_DISPLAY=y
CONFIG_XNU_NATIVE_MOBILE_DISPLAY=n
CONFIG_XNU_ARMVIRT_PLATFORM=n
CONFIG_XNU_NATIVE_UFS=y
CONFIG_XNU_NATIVE_AES=y
CONFIG_XNU_NATIVE_RAM_BLOCK=y
CONFIG_XNU_OWNER_DATA_MOUNT=y
CONFIG_XNU_OWNER_DATA_VOLUME_UUID="5A1B2C3D-4E5F-6071-8293-A4B5C6D7E8F9"
CONFIG_XNU_SHENG_PMGR=y
CONFIG_XNU_OWNER_ROOT_AUDIT=y
CONFIG_XNU_OWNER_ROOT_TRUST=y
CONFIG_XNU_OWNER_CACHE_MOUNT=y
CONFIG_XNU_OWNER_CACHE_STARTUP=y
CONFIG_XNU_OWNER_BOOT_MANIFEST=y
CONFIG_XNU_OWNER_UNION_SYSTEMOS=y
CONFIG_XNU_OWNER_CACHE_VOLUME_UUID="8846FE78-2910-4297-AF97-D59BB6F8FC16"
CONFIG_XNU_NABU_UNVERIFIED_OWNER=y
CONFIG_XNU_NABU_ROOT_BUNDLE=y
CONFIG_XNU_NATIVE_ADRENO=y
CONFIG_XNU_BOOT_PROGRESS=n
CONFIG_XNU_NATIVE_VIRTIO_BLOCK=n
CONFIG_XNU_EXTRA_CFLAGS="-Wno-reserved-identifier -Wno-pre-c11-compat -Wno-missing-designated-field-initializers -Wno-suggest-override -Wno-unnecessary-virtual-specifier -Wno-suggest-destructor-override -Wno-ms-bitfield-padding -DXNU_QCOM_USB_DEBUG=1 -I/root/dwc3/vendor/QcomXnuUsbDebug/include"
```
